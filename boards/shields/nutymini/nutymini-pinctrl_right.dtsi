
#include <dt-bindings/zmk/matrix_transform.h>
#include <dt-bindings/pinctrl/nrf-pinctrl.h>
#include "nutymini-layouts.dtsi"

&pinctrl {
    /*
    i2c0_default: i2c0_default {
        group1 {
            psels = <NRF_PSEL(TWIM_SDA, 0, 5)>,
                <NRF_PSEL(TWIM_SCL, 1, 11)>;
            //bias-pull-up;
        };
    };
    i2c0_sleep: i2c0_sleep {
        group1 {
            psels = <NRF_PSEL(TWIM_SDA, 0, 5)>,
                <NRF_PSEL(TWIM_SCL, 1, 11)>;
            low-power-enable;
        };
    };*/
};

//&xiao_i2c {
    /*
    pinctrl-0 = <&i2c0_default>;
    pinctrl-1 = <&i2c0_sleep>;
    pinctrl-names = "default", "sleep";
    */
//};



