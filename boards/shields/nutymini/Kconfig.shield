## boards/shields/nutymini/Kconfig.shield
```kconfig
# No whitespace after the comma or in your part name!
config SHIELD_NUTYMINI_LEFT
    def_bool $(shields_list_contains,nutymini_left)

# No whitespace after the comma or in your part name!
config SHIELD_NUTYMINI_RIGHT
    def_bool $(shields_list_contains,nutymini_right)

# No whitespace after the comma or in the keyboard name!
config SHIELD_NUTYMINI_DONGLE
    def_bool $(shields_list_contains,nutymini_dongle)
```

## config/west.yml
```yaml
manifest:
  remotes:
    - name: zmkfirmware
      url-base: https://github.com/zmkfirmware
    # Additional modules containing boards/shields/custom code can be listed here as well
    - name: caksoylar  # <-- new entry
      url-base: https://github.com/caksoylar  # See https://docs.zephyrproject.org/3.2.0/develop/west/manifest.html#projects
    - name: mctechnology17
      url-base: https://github.com/mctechnology17
    - name: petejohanson
      url-base: https://github.com/petejohanson

  projects:
    - name: zmk
      remote: zmkfirmware
      revision: v0.3.0
      import: app/west.yml
    - name: zmk-rgbled-widget 
      remote: caksoylar
      revision: main
    - name: cirque-input-module
      remote: petejohanson
      revision: main

  self:
    path: config
```
