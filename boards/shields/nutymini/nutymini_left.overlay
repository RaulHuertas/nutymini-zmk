/*
 * Copyright (c) 2020 Pete Johanson
 *
 * SPDX-License-Identifier: MIT
 */

#include "nutymini.dtsi"

#include "nutymini-pinctrl_left.dtsi"

&kscan0 {
  diode-direction = "row2col";
	col-gpios
		= <&gpio0 3 (GPIO_ACTIVE_HIGH | GPIO_PULL_DOWN)>   //Col0
		, <&gpio0 28 (GPIO_ACTIVE_HIGH | GPIO_PULL_DOWN)>   //Col1
		, <&gpio0 29 (GPIO_ACTIVE_HIGH | GPIO_PULL_DOWN)>   //Col2
		, <&gpio0 4 (GPIO_ACTIVE_HIGH | GPIO_PULL_DOWN)>   //Col3
		, <&gpio0 5 (GPIO_ACTIVE_HIGH | GPIO_PULL_DOWN)>   //Col4
		, <&gpio1 11 (GPIO_ACTIVE_HIGH | GPIO_PULL_DOWN)>   //Col5
		;
  row-gpios
    = <&gpio0 9  GPIO_ACTIVE_HIGH>     //Row0
    , <&gpio0 10  GPIO_ACTIVE_HIGH>     //Row1
    , <&gpio1 12 GPIO_ACTIVE_HIGH>    //Row2
    , <&gpio1 13 GPIO_ACTIVE_HIGH>    //Row3
    ;

};



&xiao_i2c {
    status = "disabled";
    pinctrl-0 = <&i2c0_default>;
    pinctrl-1 = <&i2c0_sleep>;
    pinctrl-names = "default", "sleep";


};



&glidepoint_listener {
    status = "okay";
};



